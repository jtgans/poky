## build/conf/bblayers.conf
```bitbake
# LAYER_CONF_VERSION is increased each time build/conf/bblayers.conf
# changes incompatibly
LCONF_VERSION = "6"

BBPATH = "${TOPDIR}"
BBFILES ?= ""

BBLAYERS ?= " \
  /home/${USER}/Projects/navi/poky/meta \
  /home/${USER}/Projects/navi/poky/meta-yocto \
  /home/${USER}/Projects/navi/poky/meta-yocto-bsp \
  /home/${USER}/Projects/navi/poky/meta-intel \
  /home/${USER}/Projects/navi/poky/meta-intel/meta-crownbay \
  "
BBLAYERS_NON_REMOVABLE ?= " \
  /home/${USER}/Projects/navi/poky/meta \
  /home/${USER}/Projects/navi/poky/meta-yocto \
  "

MACHINE ?= "crownbay-noemgd"
```
